## conf/layer.conf
```bitbake
# We have a conf and classes directory, add to BBPATH
BBPATH .= ":${LAYERDIR}"

# We have recipes-* directories, add to BBFILES
BBFILES += "${LAYERDIR}/recipes-*/*/*.bb \
            ${LAYERDIR}/recipes-*/*/*.bbappend"

BBFILE_COLLECTIONS += "meta-yocto-coffee-qemuarm"
BBFILE_PATTERN_meta-yocto-coffee-qemuarm = "^${LAYERDIR}/"
BBFILE_PRIORITY_meta-yocto-coffee-qemuarm = "6"

LAYERDEPENDS_meta-yocto-coffee-qemuarm = "core"
LAYERSERIES_COMPAT_meta-yocto-coffee-qemuarm = "kirkstone"
```

## conf/local.conf.sample
```bitbake
MACHINE ??= "qemuarm"

# changes from meta-qemuarm-virt layer
include conf/machine/${MACHINE}-extra.conf

DISTRO_FEATURES:append = " rauc"
IMAGE_INSTALL:append = " u-boot-selection"
IMAGE_BOOT_FILES:append = " u-boot-selection.img"
RAUC_KEYRING_FILE="${THISDIR}/../../../meta-distro-coffee/openssl-ca/dev/ca.cert.pem"
RAUC_KEY_FILE="${THISDIR}/../../../meta-distro-coffee/openssl-ca/dev/private/development-1.key.pem"
RAUC_CERT_FILE="${THISDIR}/../../../meta-distro-coffee/openssl-ca/dev/development-1.cert.pem"

DL_DIR ?= "${BSPDIR}/downloads"
SSTATE_DIR ?= "${BSPDIR}/sstate-cache"
INHERIT += "rm_work"

DISTRO ?= "coffee"
PACKAGE_CLASSES ?= "package_ipk"

EXTRA_IMAGE_FEATURES ?= "debug-tweaks"
USER_CLASSES ?= "buildstats"
PATCHRESOLVE = "noop"

BB_DISKMON_DIRS ??= "\
    STOPTASKS,${TMPDIR},1G,100K \
    STOPTASKS,${DL_DIR},1G,100K \
    STOPTASKS,${SSTATE_DIR},1G,100K \
    STOPTASKS,/tmp,100M,100K \
    ABORT,${TMPDIR},100M,1K \
    ABORT,${DL_DIR},100M,1K \
    ABORT,${SSTATE_DIR},100M,1K \
    ABORT,/tmp,10M,1K"

CONF_VERSION = "2"
```

## conf/machine/qemuarm-extra.conf
```bitbake
IMAGE_FSTYPES += "wic"
WKS_FILE ?= "qemuarm-uboot.wks"
IMAGE_BOOT_FILES ?= "uboot.env"

# Include kernel in rootfs
IMAGE_INSTALL:append = " kernel-image"

EXTRA_IMAGEDEPENDS += "u-boot"
UBOOT_MACHINE = "qemu_arm_defconfig"

# Include u-boot default environment file
UBOOT_INITIAL_ENV = "uboot-init.env"
UBOOT_ENV_SIZE = "0x40000"

# Install uboot environment tools
IMAGE_INSTALL:append = " u-boot-fw-utils"

QB_MEM = "-m 512"
QB_DEFAULT_BIOS = "u-boot.bin"
QB_DRIVE_TYPE = "/dev/vdb"
```

## wic/qemuarm-uboot.wks
```
# The partitionging scheme provides:
# * a bootloader partition with the u-boot environment in a file
# * two root file system partitions for atomic updates
# * a common data partition

# Note: The fstab is modified via the recipe base-files_%.bbappend, because the modification must also be included in the RAUC bundle.
#       This would not be the case if the fstab was modified by WIC.

part --align 1024 --extra-space 50M  --fstype=ext4 --mkfs-extraopts="-O ^metadata_csum" --label uboot     --source bootimg-partition
part --align 1024 --extra-space 300M --fstype=ext4 --mkfs-extraopts="-O ^metadata_csum" --label coffeea   --source rootfs
part --align 1024 --extra-space 300M --fstype=ext4 --mkfs-extraopts="-O ^metadata_csum" --label coffeeb   --source rootfs
part --align 1024 --fixed-size 200M  --fstype=ext4                                      --label workspace
```
